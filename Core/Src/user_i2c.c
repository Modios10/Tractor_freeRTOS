#include "main.h"
#include "user_i2c.h"

void USER_I2C1_Init(void)
{
    /* -------------------------------- */
    /* Clocks                           */
    /* -------------------------------- */

    RCC->APB2ENR |= (1U << 3); /* GPIOB */

    RCC->APB1ENR |= (1U << 21); /* I2C1 */

    /* -------------------------------- */
    /* PB6 SCL                          */
    /* PB7 SDA                          */
    /* AF Open Drain 50MHz              */
    /* -------------------------------- */

    GPIOB->CRL &= ~(0xFFU << 24);

    GPIOB->CRL |=  (0xFFU << 24);

    /* -------------------------------- */
    /* Reset I2C                        */
    /* -------------------------------- */

    I2C1->CR1 |= (1U << 15);

    I2C1->CR1 &= ~(1U << 15);

    /* -------------------------------- */
    /* APB1 = 32MHz                     */
    /* -------------------------------- */

    I2C1->CR2 = 32;

    /*
     * Standard mode 100kHz
     *
     * CCR = 160
     *
     * 32MHz / (2 * 100kHz)
     */

    I2C1->CCR = 160;

    /*
     * TRISE
     *
     * 1000ns / 31.25ns + 1
     */

    I2C1->TRISE = 33;

    /* Enable I2C */

    I2C1->CR1 |= (1U << 0);
}

/* ------------------------------------ */
/* START                                */
/* ------------------------------------ */

void USER_I2C1_Start(void)
{
    I2C1->CR1 |= (1U << 8);

    while(!(I2C1->SR1 & (1U << 0)));

    (void)I2C1->SR1;
}

/* ------------------------------------ */
/* STOP                                 */
/* ------------------------------------ */

void USER_I2C1_Stop(void)
{
    I2C1->CR1 |= (1U << 9);
}

/* ------------------------------------ */
/* ADDRESS                              */
/* ------------------------------------ */

void USER_I2C1_Write_Address(uint8_t address)
{
    I2C1->DR = address;

    while(!(I2C1->SR1 & (1U << 1)));

    (void)I2C1->SR1;

    (void)I2C1->SR2;
}

/* ------------------------------------ */
/* WRITE BYTE                           */
/* ------------------------------------ */

void USER_I2C1_Write(uint8_t data)
{
    while(!(I2C1->SR1 & (1U << 7)));

    I2C1->DR = data;

    while(!(I2C1->SR1 & (1U << 2)));
}